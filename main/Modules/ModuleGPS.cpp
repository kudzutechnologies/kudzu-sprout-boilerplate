#include "ModuleGPS.hpp"
#include "Modules/ModuleVBus.hpp"
#include "Modules/ModuleSensorHub.hpp"
#include "Modules/ModuleUART0.hpp"
#include "ModuleManager.hpp"
#include "Utilities/SensorConfig.hpp"
#include "KudzuKernel.hpp"
#include "Sherlock.hpp"
#include "esp_log.h"

/**
 * Instantiate singleton
 */
_ModuleGPS ModuleGPS;

#define POWER_RAMPDOWN_TIMEOUT 		15000 / portTICK_PERIOD_MS

#define CHUNK_TRANSMISSION_SIZE 	64

/**
 * The GPS sensor configuration
 */
static SensorConfig sensor("gps");

/**
 * (Optional) If your module requires a non-volatile storage,
 * fill-in this structure with the fields you want to save.
 */
struct GPSNvsConfig {
	int fixTimeout;
};

const uint8_t AGPS[] = {
  0xb5, 0x62, 0x13, 0x40, 0x18, 0x00, 0x10, 0x00, 0x00, 0x12, 0xe4, 0x07,
  0x04, 0x14, 0x16, 0x09, 0x29, 0x00, 0x00, 0xcc, 0xbf, 0x19, 0x0a, 0x00,
  0x00, 0x00, 0x00, 0x00, 0x00, 0x00, 0x86, 0xbf, 0xb5, 0x62, 0x13, 0x40,
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  0x9d, 0xb6, 0x87, 0x35, 0x2f, 0xb4, 0x43, 0x24, 0xa5, 0x34, 0x05, 0xca
};

struct WriteChunkEvent {
	const char * 	ptr;
	size_t 				ofs;
	size_t 				len;
	int32_t 			evt;
};

/**
 * Module configuration
 */
static const ModuleConfig config = {
	.name = "drv.gps",
	.title = "GPS Controller",
  .category = MODULE_CATEGORY_SENSOR,
	.nv_size = sizeof(GPSNvsConfig),
	.nv_version = 1,
	.runlevels = {
		RUNLEVEL_EXT_POWER
	},
	.activate = USER_ACTIVATE | DEFAULT_INACTIVE,
	.depends = {
		&ModuleNMEAParser, 	// Implicitly activates UART0
		&ModuleVBus		   		// GPS is powered by VBus
	}};

/**
 * Configuration forwarding
 */
static const char *TAG = config.name;
const ModuleConfig &_ModuleGPS::getModuleConfig() { return config; }

///////////////////////////////
// Module life-cycle methods
///////////////////////////////

_ModuleGPS::_ModuleGPS()
	: Module(), WithFSM(), activeTimer(NULL), io_conf(), v_fix(false),
	  v_siv_gps(0), v_siv_glonass(0), v_siv_galileo(0),
	  fix_cog(0), fix_speed(0)
{
	memset(v_sat_in_view, 0, 40);
	snprintf(v_sat_in_view, 40, "GPS Off");
}

/**
 * (Optional) Implement this method to initialize your module
 */
void _ModuleGPS::setup()
{
	TRACE_LOGD(TAG, "Setup");
	EVENT_HANDLER_REGISTER(gps_events, ESP_EVENT_ANY_ID);
	EVENT_HANDLER_REGISTER_ON(ModuleNMEAParser, nmea_events, ESP_EVENT_ANY_ID);
	EVENT_HANDLER_REGISTER_ON(ModuleSensorHub, sensorhub_events, ESP_EVENT_ANY_ID);
}

/**
 * (Optional) Implement this method to handle activation of your module
 */
void _ModuleGPS::activate()
{
	TRACE_LOGD(TAG, "Activating");
	snprintf(v_sat_in_view, 40, "0 (0 GP, 0 GA, 0 GL)");

	WriteChunkEvent ev = {
		.ptr = (const char*)AGPS,
		.ofs = 0,
		.len = sizeof(AGPS),
		.evt = EVENT_GPS_AGPS_DONE,
	};
	eventPost(EVENT_GPS_WRITE_CHUNK, &ev, sizeof(ev));

	// Immediately acknowledge the activation
	ackActivate();
}

/**
 * Deactivate module
 */
void _ModuleGPS::deactivate()
{
	snprintf(v_sat_in_view, 40, "GPS Off");
	eventPost(EVENT_GPS_LOST, NULL, 0);
	ackDeactivate();
}

///////////////////////////////
// User interface binding
///////////////////////////////

/**
 * (Optional) Return the list of configuration options to expose to the user
 * for this module;
 */
std::vector<ValueDefinition> _ModuleGPS::configOptions()
{
	// GPSNvsConfig *conf = (GPSNvsConfig *)nvs();

	return {
		// {"GPS Fix timeout", 		BIND_INT(conf->fixTimeout), 						WIDGET_NUMBER()},
		{"GPS Fix Acquired", 		BIND_BOOL(this->v_fix), 								WIDGET_LED(WLED_GREEN)},
		{"Satellites in view", 	BIND_FIXED_STRING(v_sat_in_view, 40),  	WIDGET_LABEL(),
		 "In GPS (GP), Glonass (GL) or Galileo (GA) constellations" },
	};
};

/**
 * (Optional) Implement this method if you want to take any action at UI save
 */
void _ModuleGPS::configDidSave()
{
	if (configChanged)
	{
		configChanged = false;
		nvsSave();

		// Restart
		Modules.restart(this)->andIgnore();
	}
}

/**
 * Initialize NVS with the default value
 */
void _ModuleGPS::nvsReset(void *nvs)
{
	GPSNvsConfig *conf = (GPSNvsConfig *)nvs;

	// By default start in AP mode
	memset(conf, 0, sizeof(GPSNvsConfig));
	conf->fixTimeout = 120;
}

///////////////////////////////////////////////////////////////////////////////
// High-level functions
///////////////////////////////////////////////////////////////////////////////

void ubx_checksum_update(uint8_t * csum, const uint8_t * data, const size_t len)
{
	for (size_t i=0; i<len; ++i) {
		csum[0] = csum[0] + data[i];
		csum[1] = csum[1] + csum[0];
	}
}

/**
 * Send data using the UBX protocol
 */
int _ModuleGPS::ubxWrite(uint8_t msgClass, uint8_t msgId, const uint8_t * data, const size_t len) {
	uint8_t hdr[6];
	uint8_t csum[2];
	int ret;
	csum[0] = csum[1] = 0;

	TRACE_LOGD(TAG, "Sending ubx message {class=%02x, id=%02x, ln=%d}", msgClass, msgId, len);

	hdr[0] = 0xB5;
	hdr[1] = 0x62;
	hdr[2] = msgClass;
	hdr[3] = msgId;
	hdr[4] = len & 0xFF;
	hdr[5] = (len >> 8) & 0xFF;
	ubx_checksum_update(csum, &hdr[2], 4);

	// Send header
  ESP_LOG_BUFFER_HEXDUMP(TAG, hdr, sizeof(hdr), ESP_LOG_DEBUG);
  ret = ModuleUART0.write((char*)hdr, sizeof(hdr));
  if (ret < 0) {
  	return ret;
  }

  // Send data
  if (len > 0) {
	  ESP_LOG_BUFFER_HEXDUMP(TAG, data, len, ESP_LOG_DEBUG);
	  ret = ModuleUART0.write((char*)data, len);
	  if (ret < 0) {
	  	return ret;
	  }
  }

  // Send checksum
	ubx_checksum_update(csum, data, len);
  ESP_LOG_BUFFER_HEXDUMP(TAG, csum, 2, ESP_LOG_DEBUG);
  ret = ModuleUART0.write((char*)csum, 2);
  if (ret < 0) {
  	return ret;
  }

  return sizeof(hdr) + sizeof(csum) + len;
}

void _ModuleGPS::ubxSendTime()
{
	uint8_t time_info[24];
	uint16_t v16;
  time_t time_raw_format;
  struct tm * ti;
  int ret;

	TRACE_LOGD(TAG, "Sending UNIX timestamp");

  time ( &time_raw_format );
  ti = localtime ( &time_raw_format );

  memset(time_info, 0, sizeof(time_info));

	time_info[0] = 0x10; // Message type
	time_info[1] = 0x00; // Version
	time_info[2] = 0x00; // Immediately apply time
	time_info[3] = 0x80; // No leap second information

	v16 = ti->tm_year + 1900;
	time_info[4] =  v16 & 0xFF;
	time_info[5] = (v16 >> 8) & 0xFF; // year

	time_info[6] =  ti->tm_mon + 1; 	// Month
	time_info[7] =  ti->tm_mday; 			// Day
	time_info[8] =  ti->tm_hour; 			// Hour
	time_info[9] =  ti->tm_min; 			// Minute
	time_info[10] =  ti->tm_sec; 			// Seconds

	v16 = 60; // Give it 1h tollerancee
	time_info[16] =  v16 & 0xFF; 			// Seconds of accuracy
	time_info[17] = (v16 >> 8)& 0xFF;

	ret = ubxWrite(0x13, 0x40, time_info, sizeof(time_info));
	if (ret < 0) {
		TRACE_LOGE(TAG, "Could not update date: error=%d", ret);
	} else {
		TRACE_LOGI(TAG, "Pushed current date to GPS module");
	}
}

///////////////////////////////////////////////////////////////////////////////
// Event handlers
///////////////////////////////////////////////////////////////////////////////

/**
 * Handler for NMEA-parser events
 */
DEFINE_EVENT_HANDLER(_ModuleGPS::nmea_events)(esp_event_base_t event_base, int32_t event_id, void *event_data) {
	// TRACE_LOGD(TAG, "event='%s', id='%d'", event_base, event_id);
	gps_t * msg = (gps_t*)event_data;;
	gps_event_t emsg;

	switch (event_id)
	{
	case EVENT_NMEA_TIMEOUT:
		TRACE_LOGD(TAG, "Received NMEA TIMEOUT");
		break;

	case EVENT_NMEA_STATEMENT_GGA:
		TRACE_LOGD(TAG, "Received NMEA GGA");
		// The 'fix' value varies
		if (v_fix) {
			if (msg->fix == GPS_FIX_INVALID) {
				v_fix = false;
				TRACE_LOGI(TAG, "Lost GPS Fix");
				eventPost(EVENT_GPS_LOST, NULL, 0);
			}
		} else {
			if (msg->fix == GPS_FIX_GPS || msg->fix == GPS_FIX_DGPS) {
				v_fix = true;
				TRACE_LOGI(TAG, "Acquired GPS Fix");
				eventPost(EVENT_GPS_FIXED, NULL, 0);
			}
		}

		TRACE_LOGD(TAG, "fix='%d', lat=%f, lng=%f", msg->fix, msg->latitude, msg->longitude);

		if (msg->fix == GPS_FIX_GPS || msg->fix == GPS_FIX_DGPS) {
			emsg.latitude = msg->latitude;
			emsg.longitude = msg->longitude;
			emsg.altitude = msg->altitude;
			eventPost(EVENT_GPS_POSITION, &emsg, sizeof(emsg));

			TRACE_LOGI(TAG, "Updated GPS fix {lat=%f, lng=%f, alt=%f}",
				msg->latitude, msg->longitude, msg->altitude);

			fix_lat = msg->latitude;
			fix_lng = msg->longitude;
			fix_alt = msg->altitude;
		}
		break;
	case EVENT_NMEA_STATEMENT_GSA:
		TRACE_LOGD(TAG, "Ignoring NMEA GGA");
		break;

	case EVENT_NMEA_STATEMENT_RMC:
		TRACE_LOGD(TAG, "Ignoring NMEA RMC");
		break;

	case EVENT_NMEA_STATEMENT_GSV:
		TRACE_LOGD(TAG, "Received NMEA GSV");

		if (msg->receiver[1] == 'P') {
			v_siv_gps = msg->sats_in_view;
		} else if (msg->receiver[1] == 'L') {
			v_siv_glonass = msg->sats_in_view;
		} else if (msg->receiver[1] == 'A') {
			v_siv_galileo = msg->sats_in_view;
		}

		snprintf(v_sat_in_view, 39, "%d (%d GP, %d GL, %d GA)",
			v_siv_gps + v_siv_glonass + v_siv_galileo,
			v_siv_gps, v_siv_glonass, v_siv_galileo);

		TRACE_LOGI(TAG, "Visible satellites: %s", v_sat_in_view);

		break;
	case EVENT_NMEA_STATEMENT_GLL:
		TRACE_LOGD(TAG, "Ignoring NMEA GLL");
		break;

	case EVENT_NMEA_STATEMENT_VTG:
		TRACE_LOGD(TAG, "EVENT_NMEA_STATEMENT_VTG");

		this->fix_cog = msg->cog;
		this->fix_speed = msg->speed;

		break;

	case EVENT_NMEA_UNDEFINED_STATEMENT:
		TRACE_LOGD(TAG, "EVENT_NMEA_UNDEFINED_STATEMENT");
		break;

	case EVENT_NMEA_GENERIC_DATA_RECEIVED:
		TRACE_LOGD(TAG, "EVENT_NMEA_GENERIC_DATA_RECEIVED");
		break;
	}
}

/**
 * Event handler for sensorhub events
 */
DEFINE_EVENT_HANDLER(_ModuleGPS::sensorhub_events)(esp_event_base_t event_base, int32_t event_id, void *event_data) {
  switch (event_id) {
  case EVENT_SENSORHUB_SAMPLE:
    TRACE_LOGD(TAG, "Responding to SensorHub sample request");
    if (v_fix) {
			ModuleSensorHub.addMeasurement(sensor, {
				{ "lat", fix_lat },
				{ "lng", fix_lng },
				{ "alt", fix_alt },
				{ "cog", fix_cog },
				{ "spd", fix_speed }
			});
    } else {
    	TRACE_LOGD(TAG, "We have no fix, not sending anything");
    }
    break;
  };
}

/**
 * Event handler for local events
 */
DEFINE_EVENT_HANDLER(_ModuleGPS::gps_events)(esp_event_base_t event_base, int32_t event_id, void *event_data) {
	int ret, len;
	WriteChunkEvent ev;

  switch (event_id) {
  case EVENT_GPS_WRITE_CHUNK:
  	memcpy(&ev, event_data, sizeof(ev));
  	len = ev.len - ev.ofs;
  	if (len > CHUNK_TRANSMISSION_SIZE) {
  		len = CHUNK_TRANSMISSION_SIZE;
  	}

  	TRACE_LOGD(TAG, "Writing chunk {ofs=%d, len=%d}", ev.ofs, len);
  	ret = ModuleUART0.write(&ev.ptr[ev.ofs], len);
  	if (ret <= 0) {
  		TRACE_LOGE(TAG, "Could not write chunk");
  		return;
  	}

  	ev.ofs += len;
  	if (ev.ofs < ev.len) {
			eventPost(EVENT_GPS_WRITE_CHUNK, &ev, sizeof(ev));
  	} else {
  		eventPost(ev.evt, NULL, 0);
  	}
  	break;

  case EVENT_GPS_AGPS_DONE:
  	TRACE_LOGI(TAG, "AGPS data pushed");
  	ubxSendTime();
  	break;

	};
};
